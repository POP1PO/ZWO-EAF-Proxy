## firmware/main/Kconfig.projbuild
```kconfig
menu "ZWO EAF persona"

    config EAF_SERIAL_HEX
        string "Serial reported by register 0x0C"
        default "6000aabbccddeeff"
        help
            Sixteen hex characters: 0x6000 followed by a six-byte MAC. A real
            unit's value identifies that unit, so the default is a placeholder
            and no unit's serial belongs in this repository.

    config EAF_START_POSITION
        int "Simulated focuser start position, in steps"
        default 3000

    config EAF_STEPS_PER_SECOND
        int "Simulated focuser speed, in steps per second"
        default 500

    config EAF_FW_MAJOR
        int "Firmware version reported by register 0x04: major"
        default 3
        help
            The captured unit reported 3.8.2. Match the release the ASIAIR knows
            about to stay quiet, or set a lower version to make it offer an
            upgrade, which is the only known route to the update protocol.

    config EAF_FW_MINOR
        int "Firmware version: minor"
        default 8

    config EAF_FW_PATCH
        int "Firmware version: patch"
        default 2

    config EAF_TEMPERATURE_CENTI
        int "Reported temperature, in hundredths of a degree Celsius"
        default 2150
        help
            Used by the simulated backend, and as the fallback the persona
            reports when a real backend cannot measure temperature.

    choice EAF_BACKEND
        prompt "Focuser backend"
        default EAF_BACKEND_SIMULATED
        help
            Which focuser the persona drives. Simulated needs no hardware and is
            how the persona is exercised against a host. The direct stepper is
            the whole proxy on one board.

        config EAF_BACKEND_SIMULATED
            bool "Simulated (no hardware)"

        config EAF_BACKEND_STEPPER
            bool "Direct stepper on ULN2003 (28BYJ-48)"

        config EAF_BACKEND_GEMINI_USBH
            bool "Gemini over USB host (ESP32-P4, EXPERIMENTAL, not implemented)"
            depends on IDF_TARGET_ESP32P4
            help
                SCAFFOLD ONLY. Drives a Gemini focuser over USB host on the P4's
                second OTG controller while the persona holds the first as a
                device. The transport and the Gemini protocol are not written
                yet; selecting this builds a stub that does not move a focuser.
                See docs/esp32p4-port.md.
    endchoice

    menu "Direct stepper backend"
        visible if EAF_BACKEND_STEPPER

        config EAF_STEPPER_IN1_GPIO
            int "GPIO wired to ULN2003 IN1"
            default 2
        config EAF_STEPPER_IN2_GPIO
            int "GPIO wired to ULN2003 IN2"
            default 3
        config EAF_STEPPER_IN3_GPIO
            int "GPIO wired to ULN2003 IN3"
            default 4
        config EAF_STEPPER_IN4_GPIO
            int "GPIO wired to ULN2003 IN4"
            default 5
            help
                Enter the pins by their board silkscreen label. The firmware
                energises them in that same order, IN1, IN2, IN3, IN4, which is
                what a 28BYJ-48 on a ULN2003 board needs. Avoid
                the native-USB pins (GPIO19/20 on an ESP32-S3).

        config EAF_STEPPER_MAX_STEPS
            int "Travel, in half-steps"
            default 60000
            help
                The configured end of travel for this scope. Targets are clamped
                into [0, this]; the protocol carries no limit and an unclamped
                move grinds the mechanism into its end stop. 60000 matches the
                ASIAIR's own default maximum.

        config EAF_STEPPER_RATE
            int "Rate ceiling, in half-steps per second"
            default 750
            help
                750 is about 11 rpm on a 28BYJ-48. There is no acceleration ramp,
                so the motor starts at this rate from standstill; the datasheet
                only guarantees a no-load start above 600 Hz, and 1000 is its
                running limit. A stall is undetectable and loses position, so
                lower this if the focuser is stiff. The firmware emits at most
                one half-step per FreeRTOS tick, so rates above the tick rate
                (1000 Hz in sdkconfig.defaults) are not reached.

        config EAF_STEPPER_START
            int "Start position when NVS holds nothing yet, in half-steps"
            default 0

        config EAF_STEPPER_INVERT
            bool "Invert direction"
            default n
            help
                Reverse which way the motor turns for a rising count, for a motor
                wired or geared the other way. The ASIAIR's own Reverse toggle is
                stored and echoed but not applied to the motor in this build, so
                set direction here or by the motor connector.

        config EAF_STEPPER_ZERO_GPIO
            int "GPIO for an optional zero button (-1 to disable)"
            default -1
            help
                Active-low button to ground, pulled up internally. Pressing it
                sets the current position to 0, the same as the ASIAIR's zero. It
                is refused while a move is running. Leave at -1 if unused.

    endmenu

endmenu
```
